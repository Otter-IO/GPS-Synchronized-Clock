// Keep track of milliseconds and update seconds if there is no GPS lock

module ms_counter(
	input clk, // Input clk
	input reset, // Reset Button
	input pps, // pps_single_clk input
	// Output for fractional seconds
	output reg[3:0] milli,
	output reg[3:0] centi,
	output reg[3:0] deci,
	output reg sec_inc, // Backup pps signal generated by this module
	output reg no_pps // Indicate that 1PPS signal has been lost
);

	reg[15:0] counter; // Counter for milliseconds
	reg[15:0] backup_count; // Counter for signal lost logic
	reg pps_wait; // Flag that signal may be lost
	reg flag; // Allows backup pps to only be high for one clk
	
	always @(posedge clk or negedge reset) begin
		if(reset == 0) begin
			counter <= 0;
			milli <= 0;
			centi <= 0;
			deci <= 0;
			no_pps <= 1;
			sec_inc <= 0;
			backup_count <= 0;
			pps_wait <= 0;
			flag <= 0;
		end else begin
		
			if(pps == 1) begin // Clear milliseconds if pps signal is recieved
				counter <= 0;
				milli <= 0;
				centi <= 0;
				deci <= 0;
			end else begin
				if(counter == 16'd50_000) begin // Increase milliseconds
					counter <= 1'b0;
					if(milli == 9) begin
						milli <= 0;
						if(centi == 9) begin
							centi <= 0;
							if(deci == 9) begin
								deci <= 0;
							end else begin
								deci <= deci + 1'b1;
							end
						end else begin
							centi <= centi + 1'b1;
						end
					end else begin
						milli <= milli + 1'b1;
					end
				end else begin
					counter <= counter + 1'b1;
				end
			end
			
			if(pps == 0) begin // Indicate that 1 sec (oscillator time) has elapsed with no 1PPS signal recived
				if(milli == 9 && centi == 9 && deci == 9 && counter == 16'd50_000 && pps_wait == 0) begin
					pps_wait <= 1;
				end else if(pps_wait == 1) begin
					pps_wait <= 1;
				end else begin
					pps_wait <= 0;
				end
			end else begin
				pps_wait <= 0;
			end
			
			if(pps_wait == 1) begin // Wait 1ms for 1PPS signal, if it is not recived then start the backup pps
				if(backup_count < 16'd50_000) begin
					backup_count <= backup_count + 1'b1;
					no_pps <= 0;
				end else begin
					backup_count <= 16'd50_001;
					no_pps <= 1;
				end
			end else begin
				no_pps <= 0;
				backup_count <= 0;
			end
			
			if(no_pps == 1 && milli == 2 && centi == 0 && deci == 0 && flag == 0) begin // Send a pulse every second if there is no gps lock
				sec_inc <= 1;
				flag <= 1;
			end else if(flag == 1) begin
				if(milli == 2) begin
					flag <= 1;
				end else begin
					flag <= 0;
				end
				sec_inc <= 0;
			end else begin
				sec_inc <= 0;
				flag <= 0;
			end
			
		end
	end


endmodule
